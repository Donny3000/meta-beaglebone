## conf/layer.conf
```bitbake
# We have a conf and classes directory, add to BBPATH
BBPATH := "${LAYERDIR}:${BBPATH}"

# We have a packages directory, add to BBFILES
BBFILES := "${BBFILES} ${LAYERDIR}/recipes-*/*/*.bb ${LAYERDIR}/recipes-*/*/*.bbappend"

BBFILE_COLLECTIONS += "meta-beaglebone"
BBFILE_PATTERN_meta-beaglebone := "^${LAYERDIR}/"
BBFILE_PRIORITY_meta-beaglebone = "7"
```

## conf/machine/beaglebone.conf
```bitbake
#@TYPE: Machine
#@NAME: BeagleBone machine
#@DESCRIPTION: Machine configuration for the http://beagleboard.org/bone board 

require conf/machine/include/ti33x.inc

DEFAULTTUNE = "armv7ahf-neon"
DPKG_ARCH = "${@base_contains("PACKAGE_CLASSES", "package_deb", "armhf", "arm", d)}"

PREFERRED_PROVIDER_virtual/kernel = "linux-ti33x-psp"
PREFERRED_PROVIDER_virtual/bootloader = "u-boot-am33x"
PREFERRED_PROVIDER_u-boot = "u-boot-am33x"

IMAGE_FSTYPES += "tar.bz2"

SERIAL_CONSOLE = "115200 ttyO0"

# and sdio
MACHINE_FEATURES += " ext3 ext4"
```
